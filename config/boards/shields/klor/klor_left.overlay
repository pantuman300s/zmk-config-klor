/*
 * Copyright (c) 2022 GEIST
 *
 * SPDX-License-Identifier: MIT
 */

#include "klor.dtsi"

&kscan0 {
	col-gpios
		= <&gpio1   19 GPIO_ACTIVE_HIGH>
		, <&gpio1   18 GPIO_ACTIVE_HIGH>
		, <&gpio1   15 GPIO_ACTIVE_HIGH>
		, <&gpio1   14 GPIO_ACTIVE_HIGH>
		, <&gpio1   16 GPIO_ACTIVE_HIGH>
		, <&xiao_d  10 GPIO_ACTIVE_HIGH>
		;
};

&left_encoder {
	status = "okay";
};