/*
 * Copyright (c) 2022 GEIST
 *
 * SPDX-License-Identifier: MIT
 */

#include "klor.dtsi"

&default_transform {
	col-offset = <6>;
};

&kscan0 {
	col-gpios
		= <&xiao_d  10 GPIO_ACTIVE_HIGH>
		, <&gpio1   16 GPIO_ACTIVE_HIGH>
		, <&gpio1   14 GPIO_ACTIVE_HIGH>
		, <&gpio1   15 GPIO_ACTIVE_HIGH>
		, <&gpio1   18 GPIO_ACTIVE_HIGH>
		, <&gpio1   19 GPIO_ACTIVE_HIGH>
		;
};

&right_encoder {
	status = "okay";
};